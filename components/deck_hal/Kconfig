## components/deck_hal/Kconfig
```kconfig
menu "DECK//OS board"

    choice DECK_BOARD
        prompt "Target board"
        default DECK_BOARD_TAB5
        help
            Hardware the firmware is built for. Each board has its own
            deck_hal implementation and sdkconfig defaults; build with
            -DDECK_BOARD=<name> so the matching defaults and components are
            used (see README).

        config DECK_BOARD_TAB5
            bool "M5Stack Tab5 + Tab5 Keyboard"

        config DECK_BOARD_TDISPLAY_P4
            bool "LilyGo T-Display P4 (4.1in AMOLED, v1.0) + K270 keyboard"
    endchoice

    config DECK_NVS_KEY_BURN
        bool "Burn an eFuse key to encrypt settings"
        default y if DECK_BOARD_TAB5
        default n
        help
            On the first boot without a key, burn a random HMAC key into a
            free eFuse key block and keep settings (Wi-Fi password, SSH key)
            encrypted with it. eFuse writes are permanent. When off, nothing
            is burned: settings stay plain, unless a key was burned earlier,
            which is then used to read them. Off by default on the T-Display
            P4 while it is being tested.

endmenu
```

## components/deck_ota/Kconfig
```kconfig
menu "DECK//OS updates"

    config DECK_OTA_REPO
        string "GitHub repository for over-the-air updates"
        default "hey-its-brian/tab5-cyberdeck"
        help
            owner/name of the repository whose Releases carry update images.
            The Tab5 takes assets ending in -ota.bin; the T-Display P4 only
            takes assets ending in -ota-tdisplay-p4.bin, so it never installs
            a Tab5 image.

endmenu
```
